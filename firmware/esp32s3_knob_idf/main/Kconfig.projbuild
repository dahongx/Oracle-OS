## firmware/esp32s3_knob_idf/main/Kconfig.projbuild
```kconfig
menu "Knob Firmware Configuration"

    choice
        prompt "LCD Driver Chip"
        default LCD_ST7789
        help
            数据手册里这块 2.8 寸屏是 ST7789V / ILI9341V 二选一(同系列不同批次贴片可能不同)。
            先选 ST7789 试烧,画面花屏/不显示的话切到 ILI9341 重新编译烧录,不用改代码。
        config LCD_ST7789
            bool "ST7789"
        config LCD_ILI9341
            bool "ILI9341"
    endchoice

endmenu
```

## firmware/esp32s3_knob_idf/sdkconfig.defaults
```kconfig
# 目标芯片
CONFIG_IDF_TARGET="esp32s3"

# 板子是 N8R2: 8MB Flash + 2MB PSRAM(Quad 模式)
CONFIG_ESPTOOLPY_FLASHSIZE_8MB=y
CONFIG_ESPTOOLPY_FLASHSIZE="8MB"
CONFIG_SPIRAM=y
CONFIG_SPIRAM_MODE_QUAD=y

# 固件本身较大(LVGL + espp 多组件),默认 1MB 单 app 分区装不下,
# 改用自定义分区表(app 分区放大到 3MB,8MB Flash 完全够用)
CONFIG_PARTITION_TABLE_CUSTOM=y
CONFIG_PARTITION_TABLE_CUSTOM_FILENAME="partitions.csv"

# 控制台走原生 USB(COM4 那个,VID:PID=303A:1001,已经实测验证过烧录/复位可靠)
CONFIG_ESP_CONSOLE_USB_SERIAL_JTAG=y

# C++ 支持(espp 大量使用异常和 RTTI)
CONFIG_COMPILER_CXX_EXCEPTIONS=y
CONFIG_COMPILER_CXX_RTTI=y

CONFIG_FREERTOS_HZ=1000
CONFIG_ESP_DEFAULT_CPU_FREQ_MHZ=240

CONFIG_ESP_SYSTEM_EVENT_TASK_STACK_SIZE=4096
CONFIG_ESP_MAIN_TASK_STACK_SIZE=8192

# LVGL 基础配置
CONFIG_LV_USE_THEME_DEFAULT=y
CONFIG_LV_MEM_SIZE_KILOBYTES=64
CONFIG_LV_FONT_MONTSERRAT_20=y
```
